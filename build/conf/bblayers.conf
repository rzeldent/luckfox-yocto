## build/conf/bblayers.conf
```bitbake
BBLAYERS ?= " \
  ${TOPDIR}/../meta-openembedded/meta-oe \
  ${TOPDIR}/../meta-openembedded/meta-python \
  ${TOPDIR}/../meta-openembedded/meta-networking \
  ${TOPDIR}/../meta-arm/meta-arm \
  ${TOPDIR}/../meta-arm/meta-arm-toolchain \
  ${TOPDIR}/../meta-rockchip \
  ${TOPDIR}/../meta-rv110x \
  ${TOPDIR}/../meta-rv-debug \
  ${TOPDIR}/../openembedded-core/meta \
"
```

## meta-luckfox/conf/distro/luckfox-project.conf
```bitbake
require conf/distro/luckfox.conf

DISTRO = "luckfox-project"

# The vendor kernel has the RV110x media ABI; mainline remains available.
LUCKFOX_KERNEL ?= "mainline"
PREFERRED_PROVIDER_virtual/kernel = "${@'linux-luckfox' if d.getVar('LUCKFOX_KERNEL') == 'vendor' else 'linux-yocto-dev'}"
OLDEST_KERNEL = "${@'5.10' if d.getVar('LUCKFOX_KERNEL') == 'vendor' else '5.15'}"
PREFERRED_RPROVIDER_kernel-module-sc3336 = "${@'linux-luckfox' if d.getVar('LUCKFOX_KERNEL') == 'vendor' else 'sc3336-driver'}"

LUCKFOX_MAINLINE_DEVICETREE := "${KERNEL_DEVICETREE}"
LUCKFOX_VENDOR_DEVICETREE = "${@{'luckfox-pico': 'rv1103g-luckfox-pico.dtb', 'luckfox-pico-plus': 'rv1103g-luckfox-pico-plus.dtb', 'luckfox-pico-mini': 'rv1103g-luckfox-pico-mini.dtb', 'luckfox-pico-max': 'rv1106g-luckfox-pico-pro-max.dtb', 'luckfox-pico-pi': 'rv1106g-luckfox-pico-pi.dtb'}.get(d.getVar('MACHINE'), '')}"
KERNEL_DEVICETREE = "${@d.getVar('LUCKFOX_VENDOR_DEVICETREE') if d.getVar('LUCKFOX_KERNEL') == 'vendor' else d.getVar('LUCKFOX_MAINLINE_DEVICETREE')}"
NONFITDT = "${@d.getVar('KERNEL_DEVICETREE').split()[0].rsplit('/', 1)[-1]}"

# Pico and Plus are RV1103 boards, despite the upstream layer's file names.
SOC_FAMILY = "${@'rv1103' if d.getVar('MACHINE') in ('luckfox-pico', 'luckfox-pico-plus', 'luckfox-pico-mini') else 'rv1106'}"
MACHINEOVERRIDES .= ":${SOC_FAMILY}"

# Driver selection must not implicitly install proprietary userspace.
MACHINE_ESSENTIAL_EXTRA_RDEPENDS:remove = "librknnmrt v4l-utils i2c-tools ${@'kernel-module-rockchip-cif-vendor kernel-module-rockchip-isp1 kernel-module-rockchip-rga kernel-module-rockchip-vdec' if d.getVar('LUCKFOX_KERNEL') == 'vendor' else ''}"
MACHINE_ESSENTIAL_EXTRA_RDEPENDS:append = " ${@'kernel-module-video-rkcif kernel-module-video-rkisp' if d.getVar('LUCKFOX_KERNEL') == 'vendor' and bb.utils.contains('LUCKFOX_FEATURES', 'camera', True, False, d) else ''} ${@'kernel-module-rga3' if d.getVar('LUCKFOX_KERNEL') == 'vendor' and bb.utils.contains('LUCKFOX_FEATURES', 'rga', True, False, d) else ''}"

MACHINE_FEATURES:remove = "bluetooth"
DISTRO_FEATURES:append = "${@' wifi' if bb.utils.contains('LUCKFOX_FEATURES', 'rtl8723bs', True, False, d) else ''}"

LUCKFOX_IMAGE_FEATURES ?= ""
LUCKFOX_ALLOW_PROPRIETARY_USERSPACE ?= "0"
LICENSE_FLAGS_ACCEPTED:append = "${@' luckfox-proprietary' if d.getVar('LUCKFOX_ALLOW_PROPRIETARY_USERSPACE') == '1' else ''}"
LUCKFOX_CMA_SIZE ?= "${@'24M' if bb.utils.contains_any('LUCKFOX_FEATURES', 'camera npu rga', True, False, d) else '0M'}"
UBOOT_EXTLINUX_KERNEL_ARGS:append = " cma=${LUCKFOX_CMA_SIZE}"

# Board defaults, not SoC defaults: RV1106 Pi uses eMMC rather than NAND.
# Override these in local.conf if the fitted NAND has different geometry.
LUCKFOX_NAND_PAGE_SIZE ?= "${@'2048' if d.getVar('MACHINE') in ('luckfox-pico-mini', 'luckfox-pico-plus', 'luckfox-pico-max') else ''}"
LUCKFOX_NAND_ERASE_SIZE ?= "${@'131072' if d.getVar('MACHINE') in ('luckfox-pico-mini', 'luckfox-pico-plus', 'luckfox-pico-max') else ''}"
LUCKFOX_NAND_SIZE ?= "${@{'luckfox-pico-mini': '134217728', 'luckfox-pico-plus': '134217728', 'luckfox-pico-max': '268435456'}.get(d.getVar('MACHINE'), '')}"
LUCKFOX_NAND_RESERVED_BLOCKS ?= "${@((int(d.getVar('LUCKFOX_NAND_SIZE') or 0) // max(1, int(d.getVar('LUCKFOX_NAND_ERASE_SIZE') or 0))) * 20 + 1023) // 1024 + 4}"
LUCKFOX_NAND_ROOTFS_OFFSET = "1179648"

MKUBIFS_ARGS = "${@'-F -m %s -e %s -c %s' % (d.getVar('LUCKFOX_NAND_PAGE_SIZE'), int(d.getVar('LUCKFOX_NAND_ERASE_SIZE') or 0) - 2 * int(d.getVar('LUCKFOX_NAND_PAGE_SIZE') or 0), (int(d.getVar('LUCKFOX_NAND_SIZE') or 0) - int(d.getVar('LUCKFOX_NAND_ROOTFS_OFFSET'))) // max(1, int(d.getVar('LUCKFOX_NAND_ERASE_SIZE') or 0)) - int(d.getVar('LUCKFOX_NAND_RESERVED_BLOCKS'))) if bb.utils.contains('LUCKFOX_FEATURES', 'spi-nand', True, False, d) else '-F -m 2048 -e 126976 -c 1020'}"
UBINIZE_ARGS = "-m ${LUCKFOX_NAND_PAGE_SIZE} -p ${LUCKFOX_NAND_ERASE_SIZE} -O ${LUCKFOX_NAND_PAGE_SIZE}"
```

## meta-luckfox/conf/layer.conf
```bitbake
BBPATH .= ":${LAYERDIR}"
BBFILES += "${LAYERDIR}/recipes-*/*/*.bb ${LAYERDIR}/recipes-*/*/*.bbappend"

BBFILE_COLLECTIONS += "luckfox-project"
BBFILE_PATTERN_luckfox-project := "^${LAYERDIR}/"
BBFILE_PRIORITY_luckfox-project = "9"
LAYERDEPENDS_luckfox-project = "core rv110x"
LAYERSERIES_COMPAT_luckfox-project = "wrynose"
addpylib ${LAYERDIR}/lib luckfox_config
```
